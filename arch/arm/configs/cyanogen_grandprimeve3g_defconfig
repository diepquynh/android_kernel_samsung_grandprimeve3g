## arch/arm/hotplug/Kconfig
```kconfig
config INTELLI_PLUG
 	bool "Hotplug for Razor Reborn"
 	depends on MSM_RUN_QUEUE_STATS
 	default n
 	help
 	  This enables kernel based multi core control.

config THUNDERPLUG_CONTROL
 	bool "Enable plugging down/up of cores using powersuspend"
	default n
 	help
 	  This driver uses powersuspend to take down the cpu cores on a octa core device.

config MSM_RUN_QUEUE_STATS
	bool "Enable collection and exporting of MSM Run Queue stats to userspace"
	default n
	help
	This option enables the driver to periodically collecting the statistics
	of kernel run queue information and calculate the load of the system.
	This information is exported to usespace via sysfs entries and userspace
	algorithms uses info and decide when to turn on/off the cpu cores.

config USES_MALI_MP2_GPU
	bool "Enable hotplugging feature for Mali GPUs"
	default n
	help
	  This option enables hotplugging features inside thunderplug 
	  for Mali 400MP2 GPUs.
```

## drivers/cpufreq/Kconfig.default_governor
```kconfig
config CPU_FREQ_DEFAULT_GOV_SMARTASS2
        bool "smartass2"
        select CPU_FREQ_GOV_SMARTASS2
        help
          Use the CPUFreq governor 'smartassV2' as default.

config CPU_FREQ_DEFAULT_GOV_WHEATLEY
	bool "wheatley"
	select CPU_FREQ_GOV_WHEATLEY
	select CPU_FREQ_GOV_PERFORMANCE
	help
          Use the CPUFreq governor 'wheatley' as default.

config CPU_FREQ_DEFAULT_GOV_LAGFREE
	bool "lagfree"
	select CPU_FREQ_GOV_LAGFREE
	select CPU_FREQ_GOV_PERFORMANCE
	---help---
	  Use the CPUFreq governor 'lagfree' as default. This allows
	  you to get a full dynamic frequency capable system by simply
	  loading your cpufreq low-level hardware driver.
	  Be aware that not all cpufreq drivers support the lagfree
	  governor. If unsure have a look at the help section of the
	  driver. Fallback governor will be the performance governor.

config CPU_FREQ_DEFAULT_GOV_LIONHEART
	bool "lionheart"
	select CPU_FREQ_GOV_LIONHEART
	help
	Use the CPUFreq governor 'lionheart' as default.

config CPU_FREQ_DEFAULT_GOV_LULZACTIVE
	bool "lulzactive2"
	select CPU_FREQ_GOV_LULZACTIVE
	help
	  Use the CPUFreq governor 'lulzactive2' as default. This option enables
	  CPUFReq governor lulzactive.
```

## drivers/cpufreq/Kconfig.governors
```kconfig
config CPU_FREQ_GOV_LULZACTIVE2
	tristate "'lulzactive' cpufreq governor"
	depends on CPU_FREQ
	help
	  When workload is greater than or equal to 60%, the 
	  governor scales up CPU to next higher step. When 
	  workload is less than 60%, governor scales down CPU
	  to next lower step. When screen is off, frequency is
	  locked to global scaling minimum frequency.

config CPU_FREQ_GOV_SMARTASS2
	tristate "'smartassV2' cpufreq governor"
	depends on CPU_FREQ
	help
	SmartassV2 is a governor (controls the frequency of the 
	CPU at each give moment) which like the first smartass is 
	generally based on the implementation of interactive with
	some major changes and the addition of a built in sleep
	profile (behaves a bit differently when screen is off vs. on).
	The smartassV2 improves the very naive scheme which the first
	smartass had

config CPU_FREQ_GOV_WHEATLEY
	tristate "'wheatley' cpufreq governor"
	depends on CPU_FREQ
     ---help---
	Building on the classic 'ondemand' governor is implemented Wheatley
	governor. The governor has two additional parameters that control
	the state.

config CPU_FREQ_GOV_LAGFREE
        tristate "'lagfree' cpufreq governor"
        depends on CPU_FREQ
        ---help---
	Lagfree is similar to ondemand. Main difference is it's optimization
	to become more battery friendly. Frequency is gracefully decreased and
	increased, unlike ondemand which jumps to 100% too often. Lagfree does
	not skip any frequency step while scaling up or down. Remember that if
	there's a requirement for sudden burst of power, lagfree can not satisfy
	that since it has to raise cpu through each higher frequency step from
	current. Some users report that video playback using lagfree stutters a little.
  
config CPU_FREQ_GOV_LIONHEART
	tristate "'lionheart' cpufreq policy governor"
	depends on CPU_FREQ
	---help---
	Lionheart is a conservative-based governor which is based on samsung
	update3 source. The tunables (such as the thresholds and sampling rate)
	were changed so the governor behaves more like the performance one, at
	the cost of battery as the scaling is very aggressive.

config CPU_FREQ_GOV_LIONFISH
	tristate "'lionfish' governor"
	depends on CPU_FREQ
	help
	  'lionfish' - this is an improved version of the conservative governor
	  that is optimized for smartphones. To avoid lag, it quickly jumps
	  to an intermediate frequency when high load is encountered at low
	  frequencies. If very high load is encountered above this intermediate
	  frequency, it jumps to a high frequency. For moderate loads, it
	  votes to increase, decrease, or maintain frequencies at each sampling
	  interval. When enough votes are gathered to raise or lower the
	  frequency, the frequency is changed. This mechanism reduces jitter
	  compared to the conservative governor. Lionfish uses proportional
	  ramping to more quickly reach suitable frequencies compared to the
	  conservative governor. By default, Lionfish also reduces frequencies
	  more aggressively than the conservative governor when loads are reduced.

	  To compile this driver as a module, choose M here: the
	  module will be called cpufreq_lionfish.

	  If in doubt, say N.
```

## drivers/gpu/mali400/Kconfig
```kconfig
menuconfig MALI400
	tristate "Mali-300/400/450 support"
	depends on ARM
	default y
	---help---
	This enables support for the ARM Mali-300, Mali-400, and Mali-450
	GPUs.

	To compile this driver as a module, choose M here: the module will be
	called mali.

choice
	depends on MALI400
	prompt "Select MALI VER"
	default MALI_VER_R4P1
	config MALI_VER_R4P1
	  bool "Mali400 Version R4P1"
	  help
	    Choose this option to select DDK version.

if MALI_VER_R4P1
source "drivers/gpu/mali400/r4p1/Kconfig"
endif

endchoice
```
